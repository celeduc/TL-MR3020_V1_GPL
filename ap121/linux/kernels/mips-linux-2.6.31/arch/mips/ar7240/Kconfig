## ap121/linux/kernels/mips-linux-2.6.31/arch/mips/ar7240/Kconfig
```kconfig
#
# USB device configuration
#

menu "AR724x GPIO Setting Support"
	depends on MACH_HORNET

config GPIO_DEBUG
	bool "GPIO DEBUG turn on/off"
	default n if MACH_AR7240
	default n
	
endmenu
```
